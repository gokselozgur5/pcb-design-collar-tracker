## CMakeLists.txt
```
cmake_minimum_required(VERSION 3.20.0)
list(APPEND BOARD_ROOT ${CMAKE_CURRENT_SOURCE_DIR}/..)
list(APPEND DTS_ROOT ${CMAKE_CURRENT_SOURCE_DIR}/..)
find_package(Zephyr REQUIRED HINTS $ENV{ZEPHYR_BASE})
project(collar_tracker_r02)
target_sources(app PRIVATE src/main.c src/uplink.c src/dns.c src/supervisor.c
                          src/recovery.c ../tracker/src/outbox.c)
target_include_directories(app PRIVATE ../factory/src ../tracker/src)
target_compile_options(app PRIVATE -Wall -Wextra -Werror)
```

## Kconfig
```
mainmenu "Collar tracker prototype"
source "Kconfig.zephyr"

menu "Collar tracker"
config TRACKER_DEVICE_ID
	string "Provisioned device identity (must match client certificate CN)"
	default ""
config TRACKER_HOST
	string "HTTPS DNS name (empty disables uplink)"
	default ""
config TRACKER_PORT
	int "HTTPS port"
	range 1 65535
	default 443
config TRACKER_SEC_TAG
	int "Factory-provisioned modem TLS credential tag"
	range 0 2147483647
	default 42
config TRACKER_INTERVAL_SECONDS
	int "Minimum start-to-start location interval"
	range 60 86400
	default 300
config TRACKER_FIX_SECONDS
	int "GNSS acquisition deadline"
	range 10 300
	default 90
config TRACKER_ATTACH_SECONDS
	int "Network registration deadline"
	range 10 300
	default 60
config TRACKER_DNS_SECONDS
	int "Caller DNS deadline; the worker retains ownership until it finishes"
	range 5 120
	default 30
endmenu
```

## prj.conf
```kconfig
CONFIG_NRF_MODEM_LIB=y
CONFIG_NRF_MODEM_LIB_ON_FAULT_APPLICATION_SPECIFIC=y
CONFIG_WATCHDOG=y
CONFIG_HWINFO=y
CONFIG_MAIN_THREAD_PRIORITY=5
CONFIG_LTE_LINK_CONTROL=y
CONFIG_LTE_NETWORK_MODE_LTE_M_GPS=y
CONFIG_LTE_LC_DNS_FALLBACK_MODULE=n
CONFIG_MODEM_KEY_MGMT=y
CONFIG_NETWORKING=y
CONFIG_NET_NATIVE=n
CONFIG_NET_SOCKETS=y
CONFIG_NET_SOCKETS_OFFLOAD=y
CONFIG_NET_IPV4=y
CONFIG_NET_IPV6=y
CONFIG_HTTP_CLIENT=y
CONFIG_FLASH=y
CONFIG_FLASH_MAP=y
CONFIG_FLASH_PAGE_LAYOUT=y
CONFIG_NVS=y
CONFIG_NVS_DATA_CRC=y
CONFIG_I2C=y
CONFIG_SENSOR=n
CONFIG_FUEL_GAUGE=n
CONFIG_USE_SEGGER_RTT=y
CONFIG_CONSOLE=y
CONFIG_RTT_CONSOLE=y
CONFIG_UART_CONSOLE=n
CONFIG_SERIAL=n
CONFIG_TFM_SECURE_UART=n
CONFIG_PRINTK=y
CONFIG_LOG=n
CONFIG_MAIN_STACK_SIZE=8192
CONFIG_HEAP_MEM_POOL_SIZE=4096
CONFIG_ASSERT=y
```

## src/main.c
```c
/* Prototype tracker; no physical radio, power or ingress qualification yet. */
#include "board_contract.h"
#include "outbox.h"
#include "uplink.h"
#include "dns.h"
#include "supervisor.h"
#include <errno.h>
#include <math.h>
#include <string.h>
#include <time.h>
#include <modem/lte_lc.h>
#include <modem/nrf_modem_lib.h>
#include <nrf_modem_gnss.h>
#include <zephyr/device.h>
#include <zephyr/drivers/flash.h>
#include <zephyr/drivers/gpio.h>
#include <zephyr/drivers/hwinfo.h>
#include <zephyr/drivers/i2c.h>
#include <zephyr/kernel.h>
#include <zephyr/kvss/nvs.h>
#include <zephyr/storage/flash_map.h>
#include <zephyr/sys/atomic.h>
#include <zephyr/sys/byteorder.h>
#include <zephyr/sys/printk.h>
#include <zephyr/sys/timeutil.h>

struct fix_data {
	double latitude, longitude;
	float accuracy;
	struct nrf_modem_gnss_datetime datetime;
};
K_SEM_DEFINE(gnss_updated, 0, 1);
K_SEM_DEFINE(registered, 0, 1);
static atomic_t accepting_fixes;
static struct nvs_fs storage;
static struct outbox queue;
static const struct device *const bus = DEVICE_DT_GET(DT_NODELABEL(i2c2));
static const struct gpio_dt_spec health = GPIO_DT_SPEC_GET(COLLAR_IO, health_enable_gpios);

static int nvs_get(void *ctx, uint16_t key, void *out, size_t n)
{
	return (int)nvs_read(ctx, key, out, n);
}
static int nvs_put(void *ctx, uint16_t key, const void *in, size_t n)
{
	return (int)nvs_write(ctx, key, in, n);
}
static int nvs_remove(void *ctx, uint16_t key) { return nvs_delete(ctx, key); }

static int storage_init(void)
{
	const struct flash_area *area;
	int ret = flash_area_open(PARTITION_ID(storage_partition), &area);
	if (ret) { return ret; }
	struct flash_pages_info page;
	ret = flash_get_page_info_by_offs(area->fa_dev, area->fa_off, &page);
	if (ret) { flash_area_close(area); return ret; }
	if (page.size == 0 || area->fa_size % page.size || area->fa_size / page.size < 3 ||
	    area->fa_size / page.size > UINT16_MAX) { flash_area_close(area); return -EINVAL; }
	storage.flash_device = area->fa_dev;
	storage.offset = area->fa_off;
	storage.sector_size = page.size;
	storage.sector_count = area->fa_size / page.size;
	flash_area_close(area);
	ret = nvs_mount(&storage);
	if (ret) { return ret; } /* Do not format a failing or incompatible store. */
	struct outbox_io io = { &storage, nvs_get, nvs_put, nvs_remove };
	return outbox_init(&queue, &io);
}

static void gnss_event(int event)
{
	if (event != NRF_MODEM_GNSS_EVT_PVT || !atomic_get(&accepting_fixes)) { return; }
	/* This callback runs in interrupt context. Main reads and validates PVT. */
	k_sem_give(&gnss_updated);
}

static void network_event(const struct lte_lc_evt *event)
{
	if (event->type == LTE_LC_EVT_NW_REG_STATUS &&
	    (event->nw_reg_status == LTE_LC_NW_REG_REGISTERED_HOME ||
	     event->nw_reg_status == LTE_LC_NW_REG_REGISTERED_ROAMING)) {
		k_sem_give(&registered);
	}
}

static uint16_t battery_mv(void)
{
	uint8_t reg = 0x08, bytes[2];
	if (!device_is_ready(bus) || i2c_write_read(bus, 0x36, &reg, 1, bytes, 2) ||
	    (sys_get_be16(bytes) & 0xfff0U) != 0x0010U) { return 0; }
	reg = 0x02;
	if (i2c_write_read(bus, 0x36, &reg, 1, bytes, 2)) { return 0; }
	uint32_t mv = (uint64_t)sys_get_be16(bytes) * 625U / 8000U;
	return mv >= 2000 && mv <= 5000 ? (uint16_t)mv : 0;
}

static int position_from_fix(const struct fix_data *f, struct position *p)
{
	const struct nrf_modem_gnss_datetime *d = &f->datetime;
	if (!isfinite(f->latitude) || !isfinite(f->longitude) || !isfinite(f->accuracy) ||
	    f->latitude < -90 || f->latitude > 90 || f->longitude < -180 ||
	    f->longitude > 180 || f->accuracy <= 0 || f->accuracy > 1000000 ||
	    d->year < 2020 || d->year > 2099 || d->month < 1 || d->month > 12 ||
	    d->hour > 23 || d->minute > 59 || d->seconds > 59 || d->ms > 999) { return -EINVAL; }
	static const uint8_t days[] = {31,28,31,30,31,30,31,31,30,31,30,31};
	unsigned max_day = days[d->month - 1] + (d->month == 2 && d->year % 4 == 0);
	if (d->day < 1 || d->day > max_day) { return -EINVAL; }
	struct tm utc = {.tm_year = d->year - 1900, .tm_mon = d->month - 1,
		.tm_mday = d->day, .tm_hour = d->hour, .tm_min = d->minute, .tm_sec = d->seconds};
	double lat = f->latitude * 1e7, lon = f->longitude * 1e7;
	*p = (struct position){
		.utc_ms = (uint64_t)timeutil_timegm64(&utc) * 1000 + d->ms,
		.latitude_e7 = (int32_t)(lat + (lat < 0 ? -0.5 : 0.5)),
		.longitude_e7 = (int32_t)(lon + (lon < 0 ? -0.5 : 0.5)),
		.accuracy_cm = (uint32_t)ceil((double)f->accuracy * 100),
		.battery_mv = battery_mv(),
	};
	return position_valid(p) ? 0 : -EINVAL;
}

static int acquire(struct position *p)
{
	int ret = lte_lc_func_mode_set(LTE_LC_FUNC_MODE_ACTIVATE_GNSS);
	if (ret) { return ret; }
	/* Configuration requires GNSS to be enabled in functional mode, but stopped. */
	if ((ret = nrf_modem_gnss_use_case_set(NRF_MODEM_GNSS_USE_CASE_MULTIPLE_HOT_START)) ||
	    (ret = nrf_modem_gnss_fix_interval_set(0)) ||
	    (ret = nrf_modem_gnss_fix_retry_set(CONFIG_TRACKER_FIX_SECONDS))) {
		return ret; /* Caller forces modem offline after every acquisition attempt. */
	}
	k_sem_reset(&gnss_updated);
	atomic_set(&accepting_fixes, 1);
	ret = nrf_modem_gnss_start();
	int64_t end = k_uptime_get() + CONFIG_TRACKER_FIX_SECONDS * INT64_C(1000);
	if (ret == 0) {
		ret = -ETIMEDOUT;
		while (k_uptime_get() < end) {
			int64_t remaining = end - k_uptime_get();
			if (remaining <= 0 || k_sem_take(&gnss_updated, K_MSEC(remaining))) { break; }
			struct nrf_modem_gnss_pvt_data_frame pvt;
			if (nrf_modem_gnss_read(&pvt, sizeof(pvt), NRF_MODEM_GNSS_DATA_PVT) ||
			    !(pvt.flags & NRF_MODEM_GNSS_PVT_FLAG_FIX_VALID)) { continue; }
			struct fix_data f = {pvt.latitude, pvt.longitude, pvt.accuracy, pvt.datetime};
			if (position_from_fix(&f, p) == 0) { ret = 0; break; }
		}
	}
	atomic_clear(&accepting_fixes);
	int stop = nrf_modem_gnss_stop();
	int off = lte_lc_func_mode_set(LTE_LC_FUNC_MODE_DEACTIVATE_GNSS);
	if (stop || off) { printk("GNSS stop=%d deactivate=%d\n", stop, off); }
	return ret;
}

static int drain(void)
{
	struct position p;
	supervisor_enter(PHASE_STORAGE, 10000);
	int ret = outbox_peek(&queue, &p);
	if (ret == -ENOENT) { return 0; }
	if (ret) { return ret; }
	k_sem_reset(&registered);
	supervisor_enter(PHASE_ATTACH, CONFIG_TRACKER_ATTACH_SECONDS * 1000U + 10000U);
	ret = lte_lc_connect_async(network_event);
	if (!ret) { ret = k_sem_take(&registered, K_SECONDS(CONFIG_TRACKER_ATTACH_SECONDS)); }
	if (ret) { return ret; }
	for (unsigned i = 0; i < 8; ++i) {
		supervisor_enter(PHASE_STORAGE, 10000);
		ret = outbox_peek(&queue, &p);
		if (ret == -ENOENT) { return 0; }
		if (ret) { return ret; }
		ret = uplink_send(&p);
		if (ret) { return ret; }
		supervisor_enter(PHASE_STORAGE, 10000);
		ret = outbox_ack(&queue, p.sequence);
		if (ret) { return ret; }
		printk("Position acknowledged: %llu\n", (unsigned long long)p.sequence);
	}
	return 0;
}

static void offline_and_drain_dns(void)
{
	/* AT shutdown and the non-cancellable resolver share one finite recovery
	 * lease. Never reinitialize the modem or reuse its job while DNS is alive. */
	supervisor_enter(PHASE_CLEANUP, 20000);
	int ret = lte_lc_func_mode_set(LTE_LC_FUNC_MODE_OFFLINE);
	if (ret) { supervisor_reset("Modem offline failed"); }
	if (!tracker_dns_wait_idle(15000)) { supervisor_reset("DNS worker did not finish"); }
}

int main(void)
{
	uint32_t reset_cause;
	int ret = supervisor_init(&reset_cause);
	if (ret) { printk("SERVICE HOLD: watchdog/reset-cause initialization %d; radio stays off\n", ret); return 0; }
	printk("Collar tracker r02 prototype; reset cause=%u; waiting 1000ms for VIO\n", reset_cause);
	k_msleep(1000);
	ret = gpio_is_ready_dt(&health) ? gpio_pin_configure_dt(&health, GPIO_OUTPUT_INACTIVE) : -ENODEV;
	if (ret) { supervisor_service_hold("Expansion disable failed"); }
	ret = device_init(bus);
	if (ret) { printk("Gauge unavailable: I2C init %d\n", ret); }
	supervisor_enter(PHASE_STORAGE, 10000);
	ret = storage_init();
	if (ret) { supervisor_service_hold("Persistent store mount or validation failed"); }
	if (reset_cause & (RESET_WATCHDOG | RESET_CPU_LOCKUP)) {
		printk("Recovery cooldown: 120 seconds before enabling the modem\n");
		supervisor_sleep(120000);
	}
	supervisor_enter(PHASE_MODEM, 30000);
	ret = nrf_modem_lib_init();
	if (ret) { supervisor_reset("Modem initialization failed"); }
	ret = lte_lc_func_mode_set(LTE_LC_FUNC_MODE_OFFLINE);
	if (ret) { supervisor_reset("Initial modem offline failed"); }
	ret = lte_lc_system_mode_set(LTE_LC_SYSTEM_MODE_LTEM_GPS, LTE_LC_SYSTEM_MODE_PREFER_AUTO);
	if (ret) { supervisor_reset("LTE-M/GNSS mode configuration failed"); }
	ret = nrf_modem_gnss_event_handler_set(gnss_event);
	if (ret) {
		supervisor_reset("GNSS handler setup failed");
	}
	int provisioned = uplink_configured();
	printk("Uplink provisioning result: %d (zero means configured)\n", provisioned);
	while (queue.healthy) {
		int64_t started = k_uptime_get();
		struct position p;
		supervisor_enter(PHASE_FIX, CONFIG_TRACKER_FIX_SECONDS * 1000U + 10000U);
		ret = acquire(&p);
		if (ret == 0) {
			supervisor_enter(PHASE_STORAGE, 10000);
			ret = outbox_enqueue(&queue, &p);
			printk("Position persistence: %d\n", ret);
			if (ret == -ENOSPC) { printk("OUTBOX FULL: newest fix rejected; older fixes retained\n"); }
		} else { printk("No usable GNSS fix: %d\n", ret); }
		offline_and_drain_dns();
		if (!queue.healthy) { supervisor_reset("Outbox mutation needs reboot reconciliation"); }
		if (queue.healthy && provisioned == 0) { printk("Uplink result: %d\n", drain()); }
		offline_and_drain_dns();
		if (!queue.healthy) { supervisor_reset("Outbox acknowledgment needs reboot reconciliation"); }
		int64_t wait = CONFIG_TRACKER_INTERVAL_SECONDS * INT64_C(1000) - (k_uptime_get() - started);
		/* Slow cycles never spin or immediately restart a failed connection. */
		supervisor_sleep((uint32_t)(wait > 60000 ? wait : 60000));
	}
	supervisor_service_hold("Tracker stopped");
}
```

## src/dns.c
```c
#include "dns.h"
#include <errno.h>
#include <stdio.h>
#include <string.h>
#include <zephyr/kernel.h>
#include <zephyr/net/socket.h>

static struct dns_slot slot;
static struct k_spinlock slot_lock;
K_SEM_DEFINE(dns_request, 0, 1);
K_SEM_DEFINE(dns_done, 0, 1);

static void resolver(void *a, void *b, void *c)
{
	ARG_UNUSED(a); ARG_UNUSED(b); ARG_UNUSED(c);
	for (;;) {
		k_sem_take(&dns_request, K_FOREVER);
		k_spinlock_key_t key = k_spin_lock(&slot_lock);
		uint32_t ticket = slot.generation;
		k_spin_unlock(&slot_lock, key);
		char port[6];
		snprintf(port, sizeof(port), "%u", CONFIG_TRACKER_PORT);
		struct zsock_addrinfo hints = {.ai_family = AF_UNSPEC, .ai_socktype = SOCK_STREAM};
		struct zsock_addrinfo *addresses = NULL;
		struct resolved_address result = {.port = CONFIG_TRACKER_PORT};
		int ret = zsock_getaddrinfo(CONFIG_TRACKER_HOST, port, &hints, &addresses);
		if (ret) { ret = -EHOSTUNREACH; }
		else if (!addresses || !addresses->ai_addr) { ret = -EHOSTUNREACH; }
		else if (addresses->ai_family == AF_INET &&
			 addresses->ai_addrlen >= sizeof(struct sockaddr_in)) {
			const struct sockaddr_in *ip = (const struct sockaddr_in *)addresses->ai_addr;
			result.version = 4;
			memcpy(result.bytes, &ip->sin_addr, 4);
		} else if (addresses->ai_family == AF_INET6 &&
			   addresses->ai_addrlen >= sizeof(struct sockaddr_in6)) {
			const struct sockaddr_in6 *ip = (const struct sockaddr_in6 *)addresses->ai_addr;
			result.version = 6;
			memcpy(result.bytes, &ip->sin6_addr, 16);
			result.scope_id = ip->sin6_scope_id;
		} else { ret = -EAFNOSUPPORT; }
		/* The same worker always releases SDK memory, including late responses.
		 * Main never aborts this thread or accesses the returned pointer. */
		if (addresses) { zsock_freeaddrinfo(addresses); }
		key = k_spin_lock(&slot_lock);
		(void)dns_slot_publish(&slot, ticket, k_uptime_get(), ret, &result);
		k_spin_unlock(&slot_lock, key);
		k_sem_give(&dns_done);
	}
}
K_THREAD_DEFINE(resolver_thread, 2048, resolver, NULL, NULL, NULL, 6, 0, 0);

int tracker_dns_lookup(struct resolved_address *address)
{
	int64_t now = k_uptime_get();
	int64_t end = now + CONFIG_TRACKER_DNS_SECONDS * INT64_C(1000);
	uint32_t ticket;
	k_sem_reset(&dns_done);
	k_spinlock_key_t key = k_spin_lock(&slot_lock);
	int ret = dns_slot_begin(&slot, now, CONFIG_TRACKER_DNS_SECONDS * 1000U, &ticket);
	k_spin_unlock(&slot_lock, key);
	if (ret) { return ret; }
	k_sem_give(&dns_request);
	for (;;) {
		key = k_spin_lock(&slot_lock);
		ret = dns_slot_poll(&slot, ticket, k_uptime_get(), address);
		k_spin_unlock(&slot_lock, key);
		if (ret != -EINPROGRESS) { return ret; }
		int64_t remaining = end - k_uptime_get();
		if (remaining > 0) { (void)k_sem_take(&dns_done, K_MSEC(remaining)); }
	}
}

bool tracker_dns_wait_idle(uint32_t timeout_ms)
{
	int64_t end = k_uptime_get() + timeout_ms;
	for (;;) {
		k_spinlock_key_t key = k_spin_lock(&slot_lock);
		bool idle = slot.state == DNS_IDLE;
		k_spin_unlock(&slot_lock, key);
		if (idle) { return true; }
		int64_t remaining = end - k_uptime_get();
		if (remaining <= 0) { return false; }
		(void)k_sem_take(&dns_done, K_MSEC(remaining));
	}
}
```

## src/dns.h
```c
#ifndef COLLAR_DNS_H
#define COLLAR_DNS_H
#include "recovery.h"
int tracker_dns_lookup(struct resolved_address *address);
bool tracker_dns_wait_idle(uint32_t timeout_ms);
#endif
```

## src/recovery.c
```c
#include "recovery.h"
#include <errno.h>
#include <limits.h>
#include <string.h>

static bool deadline(int64_t now, uint32_t budget, int64_t *end)
{
	if (now < 0 || !budget || now > INT64_MAX - budget) { return false; }
	*end = now + budget;
	return true;
}

bool lease_init(struct progress_lease *lease, int64_t now, uint32_t budget)
{
	*lease = (struct progress_lease){.phase = PHASE_BOOT};
	lease->failed = !deadline(now, budget, &lease->deadline);
	return !lease->failed;
}

bool lease_feed_allowed(struct progress_lease *lease, int64_t now)
{
	if (now < 0 || now >= lease->deadline) { lease->failed = true; }
	return !lease->failed;
}

bool lease_enter(struct progress_lease *lease, int64_t now,
		 enum tracker_phase phase, uint32_t budget)
{
	if (!lease_feed_allowed(lease, now)) { return false; }
	if ((unsigned)phase > PHASE_SERVICE || !deadline(now, budget, &lease->deadline)) {
		lease->failed = true;
		return false;
	}
	lease->phase = phase;
	return true;
}

void lease_fail(struct progress_lease *lease) { lease->failed = true; }

int dns_slot_begin(struct dns_slot *slot, int64_t now, uint32_t budget, uint32_t *ticket)
{
	if (slot->state != DNS_IDLE) { return -EBUSY; }
	if (!deadline(now, budget, &slot->deadline)) { return -EINVAL; }
	/* At most one worker exists; no ticket is reused while it can still publish. */
	*ticket = ++slot->generation;
	slot->state = DNS_PENDING;
	slot->result = -EINPROGRESS;
	memset(&slot->address, 0, sizeof(slot->address));
	return 0;
}

bool dns_slot_publish(struct dns_slot *slot, uint32_t ticket, int64_t now,
		      int result, const struct resolved_address *address)
{
	if (slot->generation != ticket ||
	    (slot->state != DNS_PENDING && slot->state != DNS_ABANDONED)) { return false; }
	if (slot->state == DNS_ABANDONED || now >= slot->deadline || now < 0) {
		/* The worker has finished and freed its SDK result. A new job is safe. */
		slot->state = DNS_IDLE;
		return false;
	}
	if (result == 0 && (!address || (address->version != 4 && address->version != 6))) {
		result = -EAFNOSUPPORT;
	}
	slot->result = result;
	if (result == 0) { slot->address = *address; }
	slot->state = DNS_READY;
	return true;
}

int dns_slot_poll(struct dns_slot *slot, uint32_t ticket, int64_t now,
		  struct resolved_address *address)
{
	if (slot->generation != ticket) { return -ESTALE; }
	if (slot->state == DNS_READY) {
		int result = slot->result;
		if (!result) { *address = slot->address; }
		slot->state = DNS_IDLE;
		return result;
	}
	if (slot->state == DNS_PENDING) {
		if (now >= slot->deadline || now < 0) {
			slot->state = DNS_ABANDONED;
			return -ETIMEDOUT;
		}
		return -EINPROGRESS;
	}
	/* IDLE here means completion was late and discarded; ABANDONED still owns
	 * the slot until the worker returns. Neither permits a stale address. */
	return -ETIMEDOUT;
}
```

## src/recovery.h
```c
#ifndef COLLAR_RECOVERY_H
#define COLLAR_RECOVERY_H
#include <stdbool.h>
#include <stdint.h>

/* Callers serialize all access to these policies. Neither performs I/O. */
enum tracker_phase {
	PHASE_BOOT, PHASE_STORAGE, PHASE_MODEM, PHASE_FIX, PHASE_ATTACH,
	PHASE_DNS, PHASE_CONNECT, PHASE_HTTP, PHASE_CLEANUP, PHASE_SLEEP, PHASE_SERVICE
};
struct progress_lease {
	int64_t deadline;
	enum tracker_phase phase;
	bool failed;
};
bool lease_init(struct progress_lease *, int64_t now, uint32_t budget_ms);
bool lease_enter(struct progress_lease *, int64_t now, enum tracker_phase, uint32_t budget_ms);
bool lease_feed_allowed(struct progress_lease *, int64_t now);
void lease_fail(struct progress_lease *);

enum dns_state { DNS_IDLE, DNS_PENDING, DNS_READY, DNS_ABANDONED };
struct resolved_address {
	uint8_t bytes[16];
	uint32_t scope_id;
	uint16_t port;
	uint8_t version; /* 4 or 6; independent of host/Zephyr AF_* numeric values. */
};
struct dns_slot {
	enum dns_state state;
	uint32_t generation;
	int64_t deadline;
	int result;
	struct resolved_address address;
};
int dns_slot_begin(struct dns_slot *, int64_t now, uint32_t budget_ms, uint32_t *ticket);
/* Worker must release every SDK addrinfo allocation before publishing. */
bool dns_slot_publish(struct dns_slot *, uint32_t ticket, int64_t now,
		      int result, const struct resolved_address *);
int dns_slot_poll(struct dns_slot *, uint32_t ticket, int64_t now, struct resolved_address *);

#endif
```

## src/supervisor.c
```c
#include "supervisor.h"
#include <errno.h>
#include <modem/nrf_modem_lib.h>
#include <zephyr/device.h>
#include <zephyr/drivers/hwinfo.h>
#include <zephyr/drivers/watchdog.h>
#include <zephyr/kernel.h>
#include <zephyr/sys/atomic.h>
#include <zephyr/sys/printk.h>

static const struct device *const watchdog = DEVICE_DT_GET(DT_NODELABEL(wdt0));
static struct progress_lease lease;
static struct k_spinlock lease_lock;
static int channel;
static atomic_t modem_failed;
K_SEM_DEFINE(supervisor_started, 0, 1);

/* Nordic invokes this in interrupt context. Do not call AT, flash, or logging. */
void nrf_modem_fault_handler(struct nrf_modem_fault_info *info)
{
	ARG_UNUSED(info);
	atomic_set(&modem_failed, 1);
}

static void monitor(void *a, void *b, void *c)
{
	ARG_UNUSED(a); ARG_UNUSED(b); ARG_UNUSED(c);
	k_sem_take(&supervisor_started, K_FOREVER);
	for (;;) {
		k_spinlock_key_t key = k_spin_lock(&lease_lock);
		if (atomic_get(&modem_failed)) { lease_fail(&lease); }
		bool feed = lease_feed_allowed(&lease, k_uptime_get());
		enum tracker_phase phase = lease.phase;
		k_spin_unlock(&lease_lock, key);
		if (!feed) {
			printk("Recovery: watchdog feed stopped in phase %d\n", phase);
			return; /* Hardware resets CPU and modem, including a stalled scheduler. */
		}
		if (wdt_feed(watchdog, channel)) {
			key = k_spin_lock(&lease_lock);
			lease_fail(&lease);
			k_spin_unlock(&lease_lock, key);
			return;
		}
		k_sleep(K_MSEC(500));
	}
}
K_THREAD_DEFINE(supervisor_thread, 1024, monitor, NULL, NULL, NULL, 0, 0, 0);

int supervisor_init(uint32_t *cause)
{
	*cause = 0;
	int ret = hwinfo_get_reset_cause(cause);
	if (ret) { return ret; }
	ret = hwinfo_clear_reset_cause();
	if (ret) { return ret; }
	if (!device_is_ready(watchdog)) { return -ENODEV; }
	struct wdt_timeout_cfg cfg = {.flags = WDT_FLAG_RESET_SOC, .window = {.min = 0, .max = 5000}};
	channel = wdt_install_timeout(watchdog, &cfg);
	if (channel < 0) { return channel; }
	/* Keep running during CPU sleep and debugger halt. Never enable System OFF. */
	ret = wdt_setup(watchdog, 0);
	if (ret) { return ret; }
	if (!lease_init(&lease, k_uptime_get(), 30000)) { return -EINVAL; }
	k_sem_give(&supervisor_started);
	return 0;
}

void supervisor_enter(enum tracker_phase phase, uint32_t budget_ms)
{
	k_spinlock_key_t key = k_spin_lock(&lease_lock);
	if (atomic_get(&modem_failed)) { lease_fail(&lease); }
	bool okay = lease_enter(&lease, k_uptime_get(), phase, budget_ms);
	k_spin_unlock(&lease_lock, key);
	if (!okay) { supervisor_reset("Expired or failed progress lease"); }
}

FUNC_NORETURN void supervisor_reset(const char *reason)
{
	k_spinlock_key_t key = k_spin_lock(&lease_lock);
	lease_fail(&lease);
	k_spin_unlock(&lease_lock, key);
	printk("Recovery requested: %s\n", reason);
	for (;;) { k_sleep(K_FOREVER); }
}

FUNC_NORETURN void supervisor_service_hold(const char *reason)
{
	printk("SERVICE HOLD: %s; storage is preserved\n", reason);
	/* Main is still executing and radio has not started or has gone offline.
	 * A known permanent fault must not create an endless flash/reset loop. */
	for (;;) {
		supervisor_enter(PHASE_SERVICE, 15000);
		k_sleep(K_SECONDS(5));
	}
}

void supervisor_sleep(uint32_t duration_ms)
{
	/* A single finite deadline bounds even a stuck idle loop. */
	supervisor_enter(PHASE_SLEEP, duration_ms + 5000);
	k_sleep(K_MSEC(duration_ms));
}
```

## src/supervisor.h
```c
#ifndef COLLAR_SUPERVISOR_H
#define COLLAR_SUPERVISOR_H
#include "recovery.h"
#include <zephyr/toolchain.h>

int supervisor_init(uint32_t *reset_cause);
void supervisor_enter(enum tracker_phase phase, uint32_t budget_ms);
FUNC_NORETURN void supervisor_reset(const char *reason);
FUNC_NORETURN void supervisor_service_hold(const char *reason);
void supervisor_sleep(uint32_t duration_ms);

#endif
```

## src/uplink.c
```c
#include "uplink.h"
#include "dns.h"
#include "supervisor.h"
#include <errno.h>
#include <fcntl.h>
#include <stdio.h>
#include <string.h>
#include <modem/modem_key_mgmt.h>
#include <zephyr/net/http/client.h>
#include <zephyr/net/socket.h>
#include <zephyr/net/tls_credentials.h>

struct reply {
	char body[40];
	size_t length;
	bool complete;
	int status;
};

static int response(struct http_response *rsp, enum http_final_call final, void *context)
{
	struct reply *reply = context;
	if (rsp->body_frag_len > sizeof(reply->body) - reply->length) { return -EMSGSIZE; }
	if (rsp->body_frag_len) {
		memcpy(reply->body + reply->length, rsp->body_frag_start, rsp->body_frag_len);
		reply->length += rsp->body_frag_len;
	}
	reply->status = rsp->http_status_code;
	reply->complete = final == HTTP_DATA_FINAL && rsp->message_complete;
	return 0;
}

int uplink_configured(void)
{
	if (!tracker_device_id_valid(CONFIG_TRACKER_DEVICE_ID) || !CONFIG_TRACKER_HOST[0]) {
		return -ENOENT;
	}
	/* DNS name only: no URL, credentials, path, whitespace or injected headers. */
	size_t n = strlen(CONFIG_TRACKER_HOST);
	if (n > 253) { return -EINVAL; }
	for (size_t i = 0; i < n; ++i) {
		char c = CONFIG_TRACKER_HOST[i];
		if (!((c >= 'a' && c <= 'z') || (c >= 'A' && c <= 'Z') ||
		    (c >= '0' && c <= '9') || c == '-' || c == '.')) { return -EINVAL; }
	}
	const enum modem_key_mgmt_cred_type types[] = {
		MODEM_KEY_MGMT_CRED_TYPE_CA_CHAIN, MODEM_KEY_MGMT_CRED_TYPE_PUBLIC_CERT,
		MODEM_KEY_MGMT_CRED_TYPE_PRIVATE_CERT,
	};
	for (size_t i = 0; i < sizeof(types) / sizeof(types[0]); ++i) {
		bool exists = false;
		int ret = modem_key_mgmt_exists(CONFIG_TRACKER_SEC_TAG, types[i], &exists);
		if (ret) { return ret; }
		if (!exists) { return -ENOENT; }
	}
	return 0;
}

int uplink_send(const struct position *p)
{
	char payload[384], port[6];
	int length = position_json(p, CONFIG_TRACKER_DEVICE_ID, payload, sizeof(payload));
	if (length < 0) { return length; }
	snprintf(port, sizeof(port), "%u", CONFIG_TRACKER_PORT);
	struct resolved_address address;
	supervisor_enter(PHASE_DNS, CONFIG_TRACKER_DNS_SECONDS * 1000U + 2000U);
	int ret = tracker_dns_lookup(&address);
	if (ret) { return ret; }
	struct sockaddr_storage peer = {0};
	socklen_t peer_size;
	int family;
	if (address.version == 4) {
		struct sockaddr_in *ip = (struct sockaddr_in *)&peer;
		family = AF_INET; peer_size = sizeof(*ip);
		ip->sin_family = family; ip->sin_port = htons(address.port);
		memcpy(&ip->sin_addr, address.bytes, 4);
	} else if (address.version == 6) {
		struct sockaddr_in6 *ip = (struct sockaddr_in6 *)&peer;
		family = AF_INET6; peer_size = sizeof(*ip);
		ip->sin6_family = family; ip->sin6_port = htons(address.port);
		ip->sin6_scope_id = address.scope_id;
		memcpy(&ip->sin6_addr, address.bytes, 16);
	} else { return -EAFNOSUPPORT; }
	int fd = -1;
	ret = -ECONNREFUSED;
	/* One address per cycle bounds connect attempts; dual-stack fallback needs
	 * field qualification. Never downgrade TLS or skip certificate validation. */
	supervisor_enter(PHASE_CONNECT, 35000);
	fd = zsock_socket(family, SOCK_STREAM, IPPROTO_TLS_1_2);
	if (fd < 0) { ret = -errno; goto done; }
	int verify = 2;
	sec_tag_t tag = CONFIG_TRACKER_SEC_TAG;
	struct timeval timeout = {.tv_sec = 30};
	if (zsock_setsockopt(fd, SOL_TLS, TLS_PEER_VERIFY, &verify, sizeof(verify)) ||
	    zsock_setsockopt(fd, SOL_TLS, TLS_SEC_TAG_LIST, &tag, sizeof(tag)) ||
	    zsock_setsockopt(fd, SOL_TLS, TLS_HOSTNAME, CONFIG_TRACKER_HOST,
			strlen(CONFIG_TRACKER_HOST)) ||
	    zsock_setsockopt(fd, SOL_SOCKET, SO_SNDTIMEO, &timeout, sizeof(timeout)) ||
	    zsock_setsockopt(fd, SOL_SOCKET, SO_RCVTIMEO, &timeout, sizeof(timeout))) {
		ret = -errno; goto done;
	}
	int flags = zsock_fcntl(fd, F_GETFL, 0);
	if (flags < 0 || zsock_fcntl(fd, F_SETFL, flags | O_NONBLOCK)) {
		ret = -errno; goto done;
	}
	if (zsock_connect(fd, (struct sockaddr *)&peer, peer_size) < 0) {
		if (errno != EINPROGRESS) { ret = -errno; goto done; }
		struct zsock_pollfd pending = {.fd = fd, .events = ZSOCK_POLLOUT};
		ret = zsock_poll(&pending, 1, 30000);
		if (ret <= 0) { ret = ret == 0 ? -ETIMEDOUT : -errno; goto done; }
		int error = 0;
		socklen_t size = sizeof(error);
		if (zsock_getsockopt(fd, SOL_SOCKET, SO_ERROR, &error, &size)) {
			ret = -errno; goto done;
		}
		if (error || !(pending.revents & ZSOCK_POLLOUT)) {
			ret = error ? -error : -ECONNABORTED; goto done;
		}
	}
	if (zsock_fcntl(fd, F_SETFL, flags)) {
		ret = -errno; goto done;
	}
	uint8_t receive[768];
	struct reply reply = {0};
	const char *headers[] = {"Connection: close\r\n", NULL};
	struct http_request request = {
		.method = HTTP_POST, .url = "/v1/positions", .protocol = "HTTP/1.1",
		.host = CONFIG_TRACKER_HOST, .port = port, .header_fields = headers,
		.content_type_value = "application/json", .payload = payload, .payload_len = length,
		.response = response, .recv_buf = receive, .recv_buf_len = sizeof(receive),
	};
	supervisor_enter(PHASE_HTTP, 35000);
	ret = http_client_req(fd, &request, 30000, &reply);
	if (ret >= 0) {
		ret = reply.complete && reply.status == 200 &&
		      tracker_ack_matches(reply.body, reply.length, p->sequence) ? 0 : -EBADMSG;
	}
done:
	supervisor_enter(PHASE_CLEANUP, 5000);
	if (fd >= 0) { zsock_close(fd); }
	return ret;
}
```
