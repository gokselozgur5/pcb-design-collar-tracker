## CMakeLists.txt
```
cmake_minimum_required(VERSION 3.20.0)
list(APPEND BOARD_ROOT ${CMAKE_CURRENT_SOURCE_DIR}/..)
list(APPEND DTS_ROOT ${CMAKE_CURRENT_SOURCE_DIR}/..)
find_package(Zephyr REQUIRED HINTS $ENV{ZEPHYR_BASE})
project(collar_tracker)
target_sources(app PRIVATE src/main.c src/outbox.c src/uplink.c)
target_include_directories(app PRIVATE ../factory/src)
target_compile_options(app PRIVATE -Wall -Wextra -Werror)
```

## Kconfig
```
mainmenu "Collar tracker prototype"
source "Kconfig.zephyr"

menu "Collar tracker"
config TRACKER_DEVICE_ID
	string "Provisioned device identity (must match client certificate CN)"
	default ""
config TRACKER_HOST
	string "HTTPS DNS name (empty disables uplink)"
	default ""
config TRACKER_PORT
	int "HTTPS port"
	range 1 65535
	default 443
config TRACKER_SEC_TAG
	int "Factory-provisioned modem TLS credential tag"
	range 0 2147483647
	default 42
config TRACKER_INTERVAL_SECONDS
	int "Minimum start-to-start location interval"
	range 60 86400
	default 300
config TRACKER_FIX_SECONDS
	int "GNSS acquisition deadline"
	range 10 300
	default 90
config TRACKER_ATTACH_SECONDS
	int "Network registration deadline"
	range 10 300
	default 60
endmenu
```

## prj.conf
```kconfig
CONFIG_NRF_MODEM_LIB=y
CONFIG_LTE_LINK_CONTROL=y
CONFIG_LTE_NETWORK_MODE_LTE_M_GPS=y
CONFIG_LTE_LC_DNS_FALLBACK_MODULE=n
CONFIG_MODEM_KEY_MGMT=y
CONFIG_NETWORKING=y
CONFIG_NET_NATIVE=n
CONFIG_NET_SOCKETS=y
CONFIG_NET_SOCKETS_OFFLOAD=y
CONFIG_NET_IPV4=y
CONFIG_NET_IPV6=y
CONFIG_HTTP_CLIENT=y
CONFIG_FLASH=y
CONFIG_FLASH_MAP=y
CONFIG_FLASH_PAGE_LAYOUT=y
CONFIG_NVS=y
CONFIG_NVS_DATA_CRC=y
CONFIG_I2C=y
CONFIG_SENSOR=n
CONFIG_FUEL_GAUGE=n
CONFIG_USE_SEGGER_RTT=y
CONFIG_CONSOLE=y
CONFIG_RTT_CONSOLE=y
CONFIG_UART_CONSOLE=n
CONFIG_SERIAL=n
CONFIG_TFM_SECURE_UART=n
CONFIG_PRINTK=y
CONFIG_LOG=n
CONFIG_MAIN_STACK_SIZE=8192
CONFIG_HEAP_MEM_POOL_SIZE=4096
CONFIG_ASSERT=y
```

## src/main.c
```c
/* Prototype tracker; no physical radio, power or ingress qualification yet. */
#include "board_contract.h"
#include "outbox.h"
#include "uplink.h"
#include <errno.h>
#include <math.h>
#include <string.h>
#include <time.h>
#include <modem/lte_lc.h>
#include <modem/nrf_modem_lib.h>
#include <nrf_modem_gnss.h>
#include <zephyr/device.h>
#include <zephyr/drivers/flash.h>
#include <zephyr/drivers/gpio.h>
#include <zephyr/drivers/i2c.h>
#include <zephyr/kernel.h>
#include <zephyr/kvss/nvs.h>
#include <zephyr/storage/flash_map.h>
#include <zephyr/sys/atomic.h>
#include <zephyr/sys/byteorder.h>
#include <zephyr/sys/printk.h>
#include <zephyr/sys/timeutil.h>

struct fix_data {
	double latitude, longitude;
	float accuracy;
	struct nrf_modem_gnss_datetime datetime;
};
K_SEM_DEFINE(gnss_updated, 0, 1);
K_SEM_DEFINE(registered, 0, 1);
static atomic_t accepting_fixes;
static struct nvs_fs storage;
static struct outbox queue;
static const struct device *const bus = DEVICE_DT_GET(DT_NODELABEL(i2c2));
static const struct gpio_dt_spec health = GPIO_DT_SPEC_GET(COLLAR_IO, health_enable_gpios);

static int nvs_get(void *ctx, uint16_t key, void *out, size_t n)
{
	return (int)nvs_read(ctx, key, out, n);
}
static int nvs_put(void *ctx, uint16_t key, const void *in, size_t n)
{
	return (int)nvs_write(ctx, key, in, n);
}
static int nvs_remove(void *ctx, uint16_t key) { return nvs_delete(ctx, key); }

static int storage_init(void)
{
	const struct flash_area *area;
	int ret = flash_area_open(PARTITION_ID(storage_partition), &area);
	if (ret) { return ret; }
	struct flash_pages_info page;
	ret = flash_get_page_info_by_offs(area->fa_dev, area->fa_off, &page);
	if (ret) { flash_area_close(area); return ret; }
	if (page.size == 0 || area->fa_size % page.size || area->fa_size / page.size < 3 ||
	    area->fa_size / page.size > UINT16_MAX) { flash_area_close(area); return -EINVAL; }
	storage.flash_device = area->fa_dev;
	storage.offset = area->fa_off;
	storage.sector_size = page.size;
	storage.sector_count = area->fa_size / page.size;
	flash_area_close(area);
	ret = nvs_mount(&storage);
	if (ret) { return ret; } /* Do not format a failing or incompatible store. */
	struct outbox_io io = { &storage, nvs_get, nvs_put, nvs_remove };
	return outbox_init(&queue, &io);
}

static void gnss_event(int event)
{
	if (event != NRF_MODEM_GNSS_EVT_PVT || !atomic_get(&accepting_fixes)) { return; }
	/* This callback runs in interrupt context. Main reads and validates PVT. */
	k_sem_give(&gnss_updated);
}

static void network_event(const struct lte_lc_evt *event)
{
	if (event->type == LTE_LC_EVT_NW_REG_STATUS &&
	    (event->nw_reg_status == LTE_LC_NW_REG_REGISTERED_HOME ||
	     event->nw_reg_status == LTE_LC_NW_REG_REGISTERED_ROAMING)) {
		k_sem_give(&registered);
	}
}

static uint16_t battery_mv(void)
{
	uint8_t reg = 0x08, bytes[2];
	if (!device_is_ready(bus) || i2c_write_read(bus, 0x36, &reg, 1, bytes, 2) ||
	    (sys_get_be16(bytes) & 0xfff0U) != 0x0010U) { return 0; }
	reg = 0x02;
	if (i2c_write_read(bus, 0x36, &reg, 1, bytes, 2)) { return 0; }
	uint32_t mv = (uint64_t)sys_get_be16(bytes) * 625U / 8000U;
	return mv >= 2000 && mv <= 5000 ? (uint16_t)mv : 0;
}

static int position_from_fix(const struct fix_data *f, struct position *p)
{
	const struct nrf_modem_gnss_datetime *d = &f->datetime;
	if (!isfinite(f->latitude) || !isfinite(f->longitude) || !isfinite(f->accuracy) ||
	    f->latitude < -90 || f->latitude > 90 || f->longitude < -180 ||
	    f->longitude > 180 || f->accuracy <= 0 || f->accuracy > 1000000 ||
	    d->year < 2020 || d->year > 2099 || d->month < 1 || d->month > 12 ||
	    d->hour > 23 || d->minute > 59 || d->seconds > 59 || d->ms > 999) { return -EINVAL; }
	static const uint8_t days[] = {31,28,31,30,31,30,31,31,30,31,30,31};
	unsigned max_day = days[d->month - 1] + (d->month == 2 && d->year % 4 == 0);
	if (d->day < 1 || d->day > max_day) { return -EINVAL; }
	struct tm utc = {.tm_year = d->year - 1900, .tm_mon = d->month - 1,
		.tm_mday = d->day, .tm_hour = d->hour, .tm_min = d->minute, .tm_sec = d->seconds};
	double lat = f->latitude * 1e7, lon = f->longitude * 1e7;
	*p = (struct position){
		.utc_ms = (uint64_t)timeutil_timegm64(&utc) * 1000 + d->ms,
		.latitude_e7 = (int32_t)(lat + (lat < 0 ? -0.5 : 0.5)),
		.longitude_e7 = (int32_t)(lon + (lon < 0 ? -0.5 : 0.5)),
		.accuracy_cm = (uint32_t)ceil((double)f->accuracy * 100),
		.battery_mv = battery_mv(),
	};
	return position_valid(p) ? 0 : -EINVAL;
}

static int acquire(struct position *p)
{
	int ret = lte_lc_func_mode_set(LTE_LC_FUNC_MODE_ACTIVATE_GNSS);
	if (ret) { return ret; }
	/* Configuration requires GNSS to be enabled in functional mode, but stopped. */
	if ((ret = nrf_modem_gnss_use_case_set(NRF_MODEM_GNSS_USE_CASE_MULTIPLE_HOT_START)) ||
	    (ret = nrf_modem_gnss_fix_interval_set(0)) ||
	    (ret = nrf_modem_gnss_fix_retry_set(CONFIG_TRACKER_FIX_SECONDS))) {
		return ret; /* Caller forces modem offline after every acquisition attempt. */
	}
	k_sem_reset(&gnss_updated);
	atomic_set(&accepting_fixes, 1);
	ret = nrf_modem_gnss_start();
	int64_t end = k_uptime_get() + CONFIG_TRACKER_FIX_SECONDS * INT64_C(1000);
	if (ret == 0) {
		ret = -ETIMEDOUT;
		while (k_uptime_get() < end) {
			int64_t remaining = end - k_uptime_get();
			if (remaining <= 0 || k_sem_take(&gnss_updated, K_MSEC(remaining))) { break; }
			struct nrf_modem_gnss_pvt_data_frame pvt;
			if (nrf_modem_gnss_read(&pvt, sizeof(pvt), NRF_MODEM_GNSS_DATA_PVT) ||
			    !(pvt.flags & NRF_MODEM_GNSS_PVT_FLAG_FIX_VALID)) { continue; }
			struct fix_data f = {pvt.latitude, pvt.longitude, pvt.accuracy, pvt.datetime};
			if (position_from_fix(&f, p) == 0) { ret = 0; break; }
		}
	}
	atomic_clear(&accepting_fixes);
	int stop = nrf_modem_gnss_stop();
	int off = lte_lc_func_mode_set(LTE_LC_FUNC_MODE_DEACTIVATE_GNSS);
	if (stop || off) { printk("GNSS stop=%d deactivate=%d\n", stop, off); }
	return ret;
}

static int drain(void)
{
	struct position p;
	int ret = outbox_peek(&queue, &p);
	if (ret == -ENOENT) { return 0; }
	if (ret) { return ret; }
	k_sem_reset(&registered);
	ret = lte_lc_connect_async(network_event);
	if (!ret) { ret = k_sem_take(&registered, K_SECONDS(CONFIG_TRACKER_ATTACH_SECONDS)); }
	if (ret) { return ret; }
	for (unsigned i = 0; i < 8; ++i) {
		ret = outbox_peek(&queue, &p);
		if (ret == -ENOENT) { return 0; }
		if (ret) { return ret; }
		ret = uplink_send(&p);
		if (ret) { return ret; }
		ret = outbox_ack(&queue, p.sequence);
		if (ret) { return ret; }
		printk("Position acknowledged: %llu\n", (unsigned long long)p.sequence);
	}
	return 0;
}

int main(void)
{
	printk("Collar tracker r01 prototype; waiting 1000ms for external VIO\n");
	k_msleep(1000);
	int ret = gpio_is_ready_dt(&health) ? gpio_pin_configure_dt(&health, GPIO_OUTPUT_INACTIVE) : -ENODEV;
	if (ret) { printk("HOLD: expansion disable failed %d\n", ret); return 0; }
	ret = device_init(bus);
	if (ret) { printk("Gauge unavailable: I2C init %d\n", ret); }
	ret = storage_init();
	if (ret) { printk("HOLD: persistent store %d; no application format\n", ret); return 0; }
	ret = nrf_modem_lib_init();
	if (ret) { printk("HOLD: modem init %d\n", ret); return 0; }
	ret = lte_lc_func_mode_set(LTE_LC_FUNC_MODE_OFFLINE);
	if (ret) { printk("HOLD: initial modem offline %d\n", ret); return 0; }
	ret = lte_lc_system_mode_set(LTE_LC_SYSTEM_MODE_LTEM_GPS, LTE_LC_SYSTEM_MODE_PREFER_AUTO);
	if (ret) { printk("HOLD: LTE-M/GNSS system mode %d\n", ret); return 0; }
	ret = nrf_modem_gnss_event_handler_set(gnss_event);
	if (ret) {
		printk("HOLD: GNSS handler %d\n", ret); return 0;
	}
	int provisioned = uplink_configured();
	printk("Uplink provisioning result: %d (zero means configured)\n", provisioned);
	while (queue.healthy) {
		int64_t started = k_uptime_get();
		struct position p;
		ret = acquire(&p);
		if (ret == 0) {
			ret = outbox_enqueue(&queue, &p);
			printk("Position persistence: %d\n", ret);
			if (ret == -ENOSPC) { printk("OUTBOX FULL: newest fix rejected; older fixes retained\n"); }
		} else { printk("No usable GNSS fix: %d\n", ret); }
		ret = lte_lc_func_mode_set(LTE_LC_FUNC_MODE_OFFLINE);
		if (ret) { printk("HOLD: GNSS offline failed %d\n", ret); break; }
		if (queue.healthy && provisioned == 0) { printk("Uplink result: %d\n", drain()); }
		ret = lte_lc_func_mode_set(LTE_LC_FUNC_MODE_OFFLINE);
		if (ret) { printk("HOLD: modem offline failed %d\n", ret); break; }
		int64_t wait = CONFIG_TRACKER_INTERVAL_SECONDS * INT64_C(1000) - (k_uptime_get() - started);
		/* Slow cycles never spin or immediately restart a failed connection. */
		k_sleep(K_MSEC(wait > 60000 ? wait : 60000));
	}
	printk("HOLD: tracker stopped; service required\n");
	return 0;
}
```

## src/outbox.c
```c
#include "outbox.h"

#include <errno.h>
#include <inttypes.h>
#include <stdio.h>
#include <string.h>

#define MAGIC UINT32_C(0x31525443)
#define RESERVATION UINT64_C(256)

static void put(uint8_t *p, uint64_t value, size_t n)
{
	for (size_t i = 0; i < n; ++i) { p[i] = (uint8_t)(value >> (8 * i)); }
}

static uint64_t get(const uint8_t *p, size_t n)
{
	uint64_t value = 0;
	for (size_t i = 0; i < n; ++i) { value |= (uint64_t)p[i] << (8 * i); }
	return value;
}

static uint32_t crc(const uint8_t *p, size_t n)
{
	uint32_t value = UINT32_MAX;
	for (size_t i = 0; i < n; ++i) {
		value ^= p[i];
		for (unsigned b = 0; b < 8; ++b) {
			value = (value >> 1) ^ (UINT32_C(0xedb88320) & (0U - (value & 1U)));
		}
	}
	return ~value;
}

static int hold(struct outbox *box, int error)
{
	box->healthy = false;
	return error;
}

bool position_valid(const struct position *p)
{
	/* 2020-01-01 through 2099-12-31. Never manufacture a timestamp. */
	return p->utc_ms >= UINT64_C(1577836800000) &&
	       p->utc_ms < UINT64_C(4102444800000) &&
	       p->latitude_e7 >= -900000000 && p->latitude_e7 <= 900000000 &&
	       p->longitude_e7 >= -1800000000 && p->longitude_e7 <= 1800000000 &&
	       p->accuracy_cm > 0 && p->accuracy_cm <= 100000000 &&
	       (p->battery_mv == 0 || (p->battery_mv >= 2000 && p->battery_mv <= 5000));
}

static int read_record(struct outbox *box, unsigned slot, struct position *p)
{
	uint8_t bytes[OUTBOX_RECORD_SIZE];
	int ret = box->io.read(box->io.context, OUTBOX_FIRST_KEY + slot, bytes, sizeof(bytes));
	if (ret == -ENOENT) { return ret; }
	if (ret < 0) { return hold(box, ret); }
	if (ret != sizeof(bytes) || get(bytes, 4) != MAGIC ||
	    get(bytes + 36, 4) != crc(bytes, 36) || get(bytes + 34, 2) != 0) {
		return hold(box, -EILSEQ);
	}
	p->sequence = get(bytes + 4, 8);
	p->utc_ms = get(bytes + 12, 8);
	/* Decode signed coordinates without implementation-defined unsigned casts. */
	int64_t lat = (int64_t)get(bytes + 20, 4);
	int64_t lon = (int64_t)get(bytes + 24, 4);
	if (lat > INT32_MAX) { lat -= INT64_C(4294967296); }
	if (lon > INT32_MAX) { lon -= INT64_C(4294967296); }
	p->latitude_e7 = (int32_t)lat;
	p->longitude_e7 = (int32_t)lon;
	p->accuracy_cm = get(bytes + 28, 4);
	p->battery_mv = get(bytes + 32, 2);
	if (!position_valid(p) || p->sequence == 0 || p->sequence >= box->limit) {
		return hold(box, -EILSEQ);
	}
	return 0;
}

int outbox_init(struct outbox *box, const struct outbox_io *io)
{
	if (!box || !io || !io->read || !io->write || !io->remove) { return -EINVAL; }
	*box = (struct outbox){ .io = *io };
	uint8_t meta[16];
	int ret = io->read(io->context, OUTBOX_META_KEY, meta, sizeof(meta));
	if (ret == -ENOENT) {
		box->limit = 1;
	} else if (ret < 0) {
		return ret;
	} else if (ret != sizeof(meta) || get(meta, 4) != MAGIC ||
		   get(meta + 12, 4) != crc(meta, 12) || get(meta + 4, 8) == 0) {
		return -EILSEQ;
	} else {
		box->limit = get(meta + 4, 8);
	}
	/* Burn unused IDs from the previous boot's reserved block. */
	box->next = box->limit;
	box->healthy = true;
	uint64_t seen[OUTBOX_CAPACITY];
	size_t count = 0;
	for (unsigned i = 0; i < OUTBOX_CAPACITY; ++i) {
		struct position p;
		ret = read_record(box, i, &p);
		if (ret == -ENOENT) { continue; }
		if (ret) { return ret; }
		for (size_t j = 0; j < count; ++j) {
			if (seen[j] == p.sequence) { return hold(box, -EILSEQ); }
		}
		seen[count++] = p.sequence;
	}
	return 0;
}

int outbox_enqueue(struct outbox *box, struct position *p)
{
	if (!box->healthy) { return -EIO; }
	if (!position_valid(p)) { return -EINVAL; }
	unsigned free_slot = OUTBOX_CAPACITY;
	for (unsigned i = 0; i < OUTBOX_CAPACITY; ++i) {
		struct position old;
		int ret = read_record(box, i, &old);
		if (ret == -ENOENT) { if (free_slot == OUTBOX_CAPACITY) { free_slot = i; } }
		else if (ret) { return ret; }
	}
	if (free_slot == OUTBOX_CAPACITY) { return -ENOSPC; }
	if (box->next == box->limit) {
		if (box->limit > UINT64_MAX - RESERVATION) { return hold(box, -EOVERFLOW); }
		uint8_t meta[16];
		uint64_t limit = box->limit + RESERVATION;
		put(meta, MAGIC, 4); put(meta + 4, limit, 8); put(meta + 12, crc(meta, 12), 4);
		int ret = box->io.write(box->io.context, OUTBOX_META_KEY, meta, sizeof(meta));
		if (ret != 0 && ret != sizeof(meta)) { return hold(box, ret < 0 ? ret : -EIO); }
		box->limit = limit;
	}
	p->sequence = box->next++;
	uint8_t bytes[OUTBOX_RECORD_SIZE] = {0};
	put(bytes, MAGIC, 4); put(bytes + 4, p->sequence, 8); put(bytes + 12, p->utc_ms, 8);
	put(bytes + 20, (uint32_t)p->latitude_e7, 4);
	put(bytes + 24, (uint32_t)p->longitude_e7, 4);
	put(bytes + 28, p->accuracy_cm, 4); put(bytes + 32, p->battery_mv, 2);
	put(bytes + 36, crc(bytes, 36), 4);
	int ret = box->io.write(box->io.context, OUTBOX_FIRST_KEY + free_slot, bytes, sizeof(bytes));
	return (ret == sizeof(bytes) || ret == 0) ? 0 : hold(box, ret < 0 ? ret : -EIO);
}

static int oldest(struct outbox *box, struct position *p, uint16_t *key)
{
	if (!box->healthy) { return -EIO; }
	bool found = false;
	for (unsigned i = 0; i < OUTBOX_CAPACITY; ++i) {
		struct position candidate;
		int ret = read_record(box, i, &candidate);
		if (ret == -ENOENT) { continue; }
		if (ret) { return ret; }
		if (!found || candidate.sequence < p->sequence) {
			*p = candidate; *key = OUTBOX_FIRST_KEY + i; found = true;
		}
	}
	return found ? 0 : -ENOENT;
}

int outbox_peek(struct outbox *box, struct position *p)
{
	uint16_t key;
	return oldest(box, p, &key);
}

int outbox_ack(struct outbox *box, uint64_t sequence)
{
	struct position p;
	uint16_t key;
	int ret = oldest(box, &p, &key);
	if (ret) { return ret; }
	if (p.sequence != sequence) { return -ESTALE; }
	ret = box->io.remove(box->io.context, key);
	return ret == 0 ? 0 : hold(box, ret < 0 ? ret : -EIO);
}

bool tracker_device_id_valid(const char *id)
{
	if (!id || !*id) { return false; }
	size_t n = 0;
	for (; id[n]; ++n) {
		char c = id[n];
		if (n >= 64 || !((c >= 'a' && c <= 'z') || (c >= 'A' && c <= 'Z') ||
		    (c >= '0' && c <= '9') || c == '-' || c == '_')) { return false; }
	}
	return true;
}

int position_json(const struct position *p, const char *device, char *out, size_t size)
{
	if (!position_valid(p) || p->sequence == 0 || !tracker_device_id_valid(device)) {
		return -EINVAL;
	}
	int ret = snprintf(out, size,
		"{\"v\":1,\"device\":\"%s\",\"sequence\":\"%" PRIu64
		"\",\"utc_ms\":%" PRIu64 ",\"latitude_e7\":%" PRId32
		",\"longitude_e7\":%" PRId32 ",\"accuracy_cm\":%" PRIu32
		",\"battery_mv\":%u}", device, p->sequence, p->utc_ms,
		p->latitude_e7, p->longitude_e7, p->accuracy_cm, (unsigned)p->battery_mv);
	return ret < 0 ? -EIO : ((size_t)ret >= size ? -ENOSPC : ret);
}

bool tracker_ack_matches(const char *body, size_t size, uint64_t sequence)
{
	char expected[40];
	int n = snprintf(expected, sizeof(expected), "{\"ack\":\"%" PRIu64 "\"}", sequence);
	return n > 0 && size == (size_t)n && memcmp(expected, body, size) == 0;
}
```

## src/outbox.h
```c
#ifndef COLLAR_OUTBOX_H
#define COLLAR_OUTBOX_H

#include <stdbool.h>
#include <stddef.h>
#include <stdint.h>

#define OUTBOX_CAPACITY 64
#define OUTBOX_RECORD_SIZE 40
#define OUTBOX_META_KEY 1
#define OUTBOX_FIRST_KEY 256

struct position {
	uint64_t sequence;
	uint64_t utc_ms;
	int32_t latitude_e7;
	int32_t longitude_e7;
	uint32_t accuracy_cm;
	uint16_t battery_mv; /* Zero means unavailable. */
};

/* Read: exact byte count or -ENOENT. Write: exact count (zero for unchanged).
 * Remove: zero. A failed mutation makes this instance unusable until reboot. */
struct outbox_io {
	void *context;
	int (*read)(void *, uint16_t, void *, size_t);
	int (*write)(void *, uint16_t, const void *, size_t);
	int (*remove)(void *, uint16_t);
};

struct outbox {
	struct outbox_io io;
	uint64_t next;
	uint64_t limit;
	bool healthy;
};

int outbox_init(struct outbox *, const struct outbox_io *);
int outbox_enqueue(struct outbox *, struct position *);
int outbox_peek(struct outbox *, struct position *);
int outbox_ack(struct outbox *, uint64_t);
bool position_valid(const struct position *);
bool tracker_device_id_valid(const char *);
int position_json(const struct position *, const char *, char *, size_t);
bool tracker_ack_matches(const char *, size_t, uint64_t);

#endif
```

## src/uplink.c
```c
#include "uplink.h"
#include <errno.h>
#include <fcntl.h>
#include <stdio.h>
#include <string.h>
#include <modem/modem_key_mgmt.h>
#include <zephyr/net/http/client.h>
#include <zephyr/net/socket.h>
#include <zephyr/net/tls_credentials.h>

struct reply {
	char body[40];
	size_t length;
	bool complete;
	int status;
};

static int response(struct http_response *rsp, enum http_final_call final, void *context)
{
	struct reply *reply = context;
	if (rsp->body_frag_len > sizeof(reply->body) - reply->length) { return -EMSGSIZE; }
	if (rsp->body_frag_len) {
		memcpy(reply->body + reply->length, rsp->body_frag_start, rsp->body_frag_len);
		reply->length += rsp->body_frag_len;
	}
	reply->status = rsp->http_status_code;
	reply->complete = final == HTTP_DATA_FINAL && rsp->message_complete;
	return 0;
}

int uplink_configured(void)
{
	if (!tracker_device_id_valid(CONFIG_TRACKER_DEVICE_ID) || !CONFIG_TRACKER_HOST[0]) {
		return -ENOENT;
	}
	/* DNS name only: no URL, credentials, path, whitespace or injected headers. */
	size_t n = strlen(CONFIG_TRACKER_HOST);
	if (n > 253) { return -EINVAL; }
	for (size_t i = 0; i < n; ++i) {
		char c = CONFIG_TRACKER_HOST[i];
		if (!((c >= 'a' && c <= 'z') || (c >= 'A' && c <= 'Z') ||
		    (c >= '0' && c <= '9') || c == '-' || c == '.')) { return -EINVAL; }
	}
	const enum modem_key_mgmt_cred_type types[] = {
		MODEM_KEY_MGMT_CRED_TYPE_CA_CHAIN, MODEM_KEY_MGMT_CRED_TYPE_PUBLIC_CERT,
		MODEM_KEY_MGMT_CRED_TYPE_PRIVATE_CERT,
	};
	for (size_t i = 0; i < sizeof(types) / sizeof(types[0]); ++i) {
		bool exists = false;
		int ret = modem_key_mgmt_exists(CONFIG_TRACKER_SEC_TAG, types[i], &exists);
		if (ret) { return ret; }
		if (!exists) { return -ENOENT; }
	}
	return 0;
}

int uplink_send(const struct position *p)
{
	char payload[384], port[6];
	int length = position_json(p, CONFIG_TRACKER_DEVICE_ID, payload, sizeof(payload));
	if (length < 0) { return length; }
	snprintf(port, sizeof(port), "%u", CONFIG_TRACKER_PORT);
	struct zsock_addrinfo hints = {.ai_family = AF_UNSPEC, .ai_socktype = SOCK_STREAM};
	struct zsock_addrinfo *addresses = NULL;
	/* The modem owns DNS timing. This prototype has no application DNS deadline. */
	int ret = zsock_getaddrinfo(CONFIG_TRACKER_HOST, port, &hints, &addresses);
	if (ret) { return -EHOSTUNREACH; }
	int fd = -1;
	ret = -ECONNREFUSED;
	/* One address per cycle bounds connect attempts; dual-stack fallback needs
	 * field qualification. Never downgrade TLS or skip certificate validation. */
	if (!addresses) { ret = -EHOSTUNREACH; goto done; }
	fd = zsock_socket(addresses->ai_family, SOCK_STREAM, IPPROTO_TLS_1_2);
	if (fd < 0) { ret = -errno; goto done; }
	int verify = 2;
	sec_tag_t tag = CONFIG_TRACKER_SEC_TAG;
	struct timeval timeout = {.tv_sec = 30};
	if (zsock_setsockopt(fd, SOL_TLS, TLS_PEER_VERIFY, &verify, sizeof(verify)) ||
	    zsock_setsockopt(fd, SOL_TLS, TLS_SEC_TAG_LIST, &tag, sizeof(tag)) ||
	    zsock_setsockopt(fd, SOL_TLS, TLS_HOSTNAME, CONFIG_TRACKER_HOST,
			strlen(CONFIG_TRACKER_HOST)) ||
	    zsock_setsockopt(fd, SOL_SOCKET, SO_SNDTIMEO, &timeout, sizeof(timeout)) ||
	    zsock_setsockopt(fd, SOL_SOCKET, SO_RCVTIMEO, &timeout, sizeof(timeout))) {
		ret = -errno; goto done;
	}
	int flags = zsock_fcntl(fd, F_GETFL, 0);
	if (flags < 0 || zsock_fcntl(fd, F_SETFL, flags | O_NONBLOCK)) {
		ret = -errno; goto done;
	}
	if (zsock_connect(fd, addresses->ai_addr, addresses->ai_addrlen) < 0) {
		if (errno != EINPROGRESS) { ret = -errno; goto done; }
		struct zsock_pollfd pending = {.fd = fd, .events = ZSOCK_POLLOUT};
		ret = zsock_poll(&pending, 1, 30000);
		if (ret <= 0) { ret = ret == 0 ? -ETIMEDOUT : -errno; goto done; }
		int error = 0;
		socklen_t size = sizeof(error);
		if (zsock_getsockopt(fd, SOL_SOCKET, SO_ERROR, &error, &size)) {
			ret = -errno; goto done;
		}
		if (error || !(pending.revents & ZSOCK_POLLOUT)) {
			ret = error ? -error : -ECONNABORTED; goto done;
		}
	}
	if (zsock_fcntl(fd, F_SETFL, flags)) {
		ret = -errno; goto done;
	}
	uint8_t receive[768];
	struct reply reply = {0};
	const char *headers[] = {"Connection: close\r\n", NULL};
	struct http_request request = {
		.method = HTTP_POST, .url = "/v1/positions", .protocol = "HTTP/1.1",
		.host = CONFIG_TRACKER_HOST, .port = port, .header_fields = headers,
		.content_type_value = "application/json", .payload = payload, .payload_len = length,
		.response = response, .recv_buf = receive, .recv_buf_len = sizeof(receive),
	};
	ret = http_client_req(fd, &request, 30000, &reply);
	if (ret >= 0) {
		ret = reply.complete && reply.status == 200 &&
		      tracker_ack_matches(reply.body, reply.length, p->sequence) ? 0 : -EBADMSG;
	}
done:
	if (fd >= 0) { zsock_close(fd); }
	zsock_freeaddrinfo(addresses);
	return ret;
}
```
