## CMakeLists.txt
```
cmake_minimum_required(VERSION 3.20.0)
list(APPEND BOARD_ROOT ${CMAKE_CURRENT_SOURCE_DIR}/..)
list(APPEND DTS_ROOT ${CMAKE_CURRENT_SOURCE_DIR}/..)
find_package(Zephyr REQUIRED HINTS $ENV{ZEPHYR_BASE})
project(collar_tracker_r03)
# TF-M runs a fourth, nested CMake process; sysbuild's child cache is not inherited.
if(NOT DEFINED USER_CACHE_DIR)
    message(FATAL_ERROR "Pass an explicit task USER_CACHE_DIR")
endif()
set_property(TARGET zephyr_property_target APPEND PROPERTY TFM_CMAKE_OPTIONS
    "-DUSER_CACHE_DIR:PATH=${USER_CACHE_DIR}")
target_sources(app PRIVATE src/main.c src/uplink.c src/trial.c src/trial_policy.c ../tracker/src/outbox.c
    ../tracker-r02/src/dns.c ../tracker-r02/src/supervisor.c ../tracker-r02/src/recovery.c)
target_include_directories(app PRIVATE ../factory/src ../tracker/src ../tracker-r02/src)
target_compile_options(app PRIVATE -Wall -Wextra -Werror)
```

## Kconfig
```
mainmenu "Collar tracker prototype"
source "Kconfig.zephyr"

menu "Collar tracker"
config TRACKER_DEVICE_ID
	string "Provisioned device identity (must match client certificate CN)"
	default ""
config TRACKER_HOST
	string "HTTPS DNS name (empty disables uplink)"
	default ""
config TRACKER_PORT
	int "HTTPS port"
	range 1 65535
	default 443
config TRACKER_SEC_TAG
	int "Factory-provisioned modem TLS credential tag"
	range 0 2147483647
	default 42
config TRACKER_INTERVAL_SECONDS
	int "Minimum start-to-start location interval"
	range 60 86400
	default 300
config TRACKER_FIX_SECONDS
	int "GNSS acquisition deadline"
	range 10 300
	default 90
config TRACKER_ATTACH_SECONDS
	int "Network registration deadline"
	range 10 300
	default 60
config TRACKER_DNS_SECONDS
	int "Caller DNS deadline; the worker retains ownership until it finishes"
	range 5 120
	default 30
config TRACKER_TRIAL_SECONDS
	int "Maximum unconfirmed update lifetime before watchdog rollback"
	range 120 3600
	default 600
config TRACKER_TRIAL_STABLE_SECONDS
	int "Minimum healthy trial lifetime before confirmation"
	range 1 60
	default 30
endmenu
```

## sysbuild.conf
```
SB_CONFIG_BOOTLOADER_MCUBOOT=y
SB_CONFIG_BOOT_SIGNATURE_TYPE_ECDSA_P256=y
SB_CONFIG_MCUBOOT_MODE_SWAP_USING_OFFSET=y
```

## prj.conf
```kconfig
CONFIG_NRF_MODEM_LIB=y
CONFIG_NRF_MODEM_LIB_ON_FAULT_APPLICATION_SPECIFIC=y
CONFIG_WATCHDOG=y
CONFIG_HWINFO=y
CONFIG_MAIN_THREAD_PRIORITY=5
CONFIG_LTE_LINK_CONTROL=y
CONFIG_LTE_NETWORK_MODE_LTE_M_GPS=y
CONFIG_LTE_LC_DNS_FALLBACK_MODULE=n
CONFIG_MODEM_KEY_MGMT=y
CONFIG_NETWORKING=y
CONFIG_NET_NATIVE=n
CONFIG_NET_SOCKETS=y
CONFIG_NET_SOCKETS_OFFLOAD=y
CONFIG_NET_IPV4=y
CONFIG_NET_IPV6=y
CONFIG_HTTP_CLIENT=y
CONFIG_FLASH=y
CONFIG_FLASH_MAP=y
CONFIG_FLASH_PAGE_LAYOUT=y
CONFIG_NVS=y
CONFIG_NVS_DATA_CRC=y
CONFIG_I2C=y
CONFIG_SENSOR=n
CONFIG_FUEL_GAUGE=n
CONFIG_USE_SEGGER_RTT=y
CONFIG_CONSOLE=y
CONFIG_RTT_CONSOLE=y
CONFIG_UART_CONSOLE=n
CONFIG_SERIAL=n
CONFIG_TFM_SECURE_UART=n
CONFIG_PRINTK=y
CONFIG_LOG=n
CONFIG_MAIN_STACK_SIZE=8192
CONFIG_HEAP_MEM_POOL_SIZE=4096
CONFIG_ASSERT=y
CONFIG_BOOTLOADER_MCUBOOT=y
CONFIG_IMG_MANAGER=y
CONFIG_STREAM_FLASH=y
CONFIG_MCUBOOT_IMG_MANAGER=y
CONFIG_MCUBOOT_BOOTLOADER_NO_DOWNGRADE=y
```

## src/main.c
```c
/* Prototype tracker; no physical radio, power or ingress qualification yet. */
#include "board_contract.h"
#include "outbox.h"
#include "uplink.h"
#include "dns.h"
#include "supervisor.h"
#include "trial.h"
#include <errno.h>
#include <math.h>
#include <string.h>
#include <time.h>
#include <modem/lte_lc.h>
#include <modem/nrf_modem_lib.h>
#include <nrf_modem_gnss.h>
#include <zephyr/device.h>
#include <zephyr/drivers/flash.h>
#include <zephyr/drivers/gpio.h>
#include <zephyr/drivers/hwinfo.h>
#include <zephyr/drivers/i2c.h>
#include <zephyr/kernel.h>
#include <zephyr/kvss/nvs.h>
#include <zephyr/storage/flash_map.h>
#include <zephyr/sys/atomic.h>
#include <zephyr/sys/byteorder.h>
#include <zephyr/sys/printk.h>
#include <zephyr/sys/timeutil.h>

struct fix_data {
	double latitude, longitude;
	float accuracy;
	struct nrf_modem_gnss_datetime datetime;
};
K_SEM_DEFINE(gnss_updated, 0, 1);
K_SEM_DEFINE(registered, 0, 1);
static atomic_t accepting_fixes;
static struct nvs_fs storage;
static struct outbox queue;
static const struct device *const bus = DEVICE_DT_GET(DT_NODELABEL(i2c2));
static const struct gpio_dt_spec health = GPIO_DT_SPEC_GET(COLLAR_IO, health_enable_gpios);

static int nvs_get(void *ctx, uint16_t key, void *out, size_t n)
{
	return (int)nvs_read(ctx, key, out, n);
}
static int nvs_put(void *ctx, uint16_t key, const void *in, size_t n)
{
	return (int)nvs_write(ctx, key, in, n);
}
static int nvs_remove(void *ctx, uint16_t key) { return nvs_delete(ctx, key); }

static int storage_init(void)
{
	const struct flash_area *area;
	int ret = flash_area_open(PARTITION_ID(storage_partition), &area);
	if (ret) { return ret; }
	struct flash_pages_info page;
	ret = flash_get_page_info_by_offs(area->fa_dev, area->fa_off, &page);
	if (ret) { flash_area_close(area); return ret; }
	if (page.size == 0 || area->fa_size % page.size || area->fa_size / page.size < 3 ||
	    area->fa_size / page.size > UINT16_MAX) { flash_area_close(area); return -EINVAL; }
	storage.flash_device = area->fa_dev;
	storage.offset = area->fa_off;
	storage.sector_size = page.size;
	storage.sector_count = area->fa_size / page.size;
	flash_area_close(area);
	ret = nvs_mount(&storage);
	if (ret) { return ret; } /* Do not format a failing or incompatible store. */
	struct outbox_io io = { &storage, nvs_get, nvs_put, nvs_remove };
	return outbox_init(&queue, &io);
}

static void gnss_event(int event)
{
	if (event != NRF_MODEM_GNSS_EVT_PVT || !atomic_get(&accepting_fixes)) { return; }
	/* This callback runs in interrupt context. Main reads and validates PVT. */
	k_sem_give(&gnss_updated);
}

static void network_event(const struct lte_lc_evt *event)
{
	if (event->type == LTE_LC_EVT_NW_REG_STATUS &&
	    (event->nw_reg_status == LTE_LC_NW_REG_REGISTERED_HOME ||
	     event->nw_reg_status == LTE_LC_NW_REG_REGISTERED_ROAMING)) {
		k_sem_give(&registered);
	}
}

static uint16_t battery_mv(void)
{
	uint8_t reg = 0x08, bytes[2];
	if (!device_is_ready(bus) || i2c_write_read(bus, 0x36, &reg, 1, bytes, 2) ||
	    (sys_get_be16(bytes) & 0xfff0U) != 0x0010U) { return 0; }
	reg = 0x02;
	if (i2c_write_read(bus, 0x36, &reg, 1, bytes, 2)) { return 0; }
	uint32_t mv = (uint64_t)sys_get_be16(bytes) * 625U / 8000U;
	return mv >= 2000 && mv <= 5000 ? (uint16_t)mv : 0;
}

static int position_from_fix(const struct fix_data *f, struct position *p)
{
	const struct nrf_modem_gnss_datetime *d = &f->datetime;
	if (!isfinite(f->latitude) || !isfinite(f->longitude) || !isfinite(f->accuracy) ||
	    f->latitude < -90 || f->latitude > 90 || f->longitude < -180 ||
	    f->longitude > 180 || f->accuracy <= 0 || f->accuracy > 1000000 ||
	    d->year < 2020 || d->year > 2099 || d->month < 1 || d->month > 12 ||
	    d->hour > 23 || d->minute > 59 || d->seconds > 59 || d->ms > 999) { return -EINVAL; }
	static const uint8_t days[] = {31,28,31,30,31,30,31,31,30,31,30,31};
	unsigned max_day = days[d->month - 1] + (d->month == 2 && d->year % 4 == 0);
	if (d->day < 1 || d->day > max_day) { return -EINVAL; }
	struct tm utc = {.tm_year = d->year - 1900, .tm_mon = d->month - 1,
		.tm_mday = d->day, .tm_hour = d->hour, .tm_min = d->minute, .tm_sec = d->seconds};
	double lat = f->latitude * 1e7, lon = f->longitude * 1e7;
	*p = (struct position){
		.utc_ms = (uint64_t)timeutil_timegm64(&utc) * 1000 + d->ms,
		.latitude_e7 = (int32_t)(lat + (lat < 0 ? -0.5 : 0.5)),
		.longitude_e7 = (int32_t)(lon + (lon < 0 ? -0.5 : 0.5)),
		.accuracy_cm = (uint32_t)ceil((double)f->accuracy * 100),
		.battery_mv = battery_mv(),
	};
	return position_valid(p) ? 0 : -EINVAL;
}

static int acquire(struct position *p)
{
	int ret = lte_lc_func_mode_set(LTE_LC_FUNC_MODE_ACTIVATE_GNSS);
	if (ret) { return ret; }
	/* Configuration requires GNSS to be enabled in functional mode, but stopped. */
	if ((ret = nrf_modem_gnss_use_case_set(NRF_MODEM_GNSS_USE_CASE_MULTIPLE_HOT_START)) ||
	    (ret = nrf_modem_gnss_fix_interval_set(0)) ||
	    (ret = nrf_modem_gnss_fix_retry_set(CONFIG_TRACKER_FIX_SECONDS))) {
		return ret; /* Caller forces modem offline after every acquisition attempt. */
	}
	k_sem_reset(&gnss_updated);
	atomic_set(&accepting_fixes, 1);
	ret = nrf_modem_gnss_start();
	int64_t end = k_uptime_get() + CONFIG_TRACKER_FIX_SECONDS * INT64_C(1000);
	if (ret == 0) {
		ret = -ETIMEDOUT;
		while (k_uptime_get() < end) {
			int64_t remaining = end - k_uptime_get();
			if (remaining <= 0 || k_sem_take(&gnss_updated, K_MSEC(remaining))) { break; }
			struct nrf_modem_gnss_pvt_data_frame pvt;
			if (nrf_modem_gnss_read(&pvt, sizeof(pvt), NRF_MODEM_GNSS_DATA_PVT) ||
			    !(pvt.flags & NRF_MODEM_GNSS_PVT_FLAG_FIX_VALID)) { continue; }
			struct fix_data f = {pvt.latitude, pvt.longitude, pvt.accuracy, pvt.datetime};
			if (position_from_fix(&f, p) == 0) { ret = 0; break; }
		}
	}
	atomic_clear(&accepting_fixes);
	int stop = nrf_modem_gnss_stop();
	int off = lte_lc_func_mode_set(LTE_LC_FUNC_MODE_DEACTIVATE_GNSS);
	if (stop || off) { printk("GNSS stop=%d deactivate=%d\n", stop, off); }
	return ret;
}

static int drain(void)
{
	struct position p;
	supervisor_enter(PHASE_STORAGE, 10000);
	int ret = outbox_peek(&queue, &p);
	if (ret == -ENOENT) { return 0; }
	if (ret) { return ret; }
	k_sem_reset(&registered);
	supervisor_enter(PHASE_ATTACH, CONFIG_TRACKER_ATTACH_SECONDS * 1000U + 10000U);
	ret = lte_lc_connect_async(network_event);
	if (!ret) { ret = k_sem_take(&registered, K_SECONDS(CONFIG_TRACKER_ATTACH_SECONDS)); }
	if (ret) { return ret; }
	for (unsigned i = 0; i < 8; ++i) {
		supervisor_enter(PHASE_STORAGE, 10000);
		ret = outbox_peek(&queue, &p);
		if (ret == -ENOENT) { return 0; }
		if (ret) { return ret; }
		ret = uplink_send(&p);
		if (ret) { return ret; }
		supervisor_enter(PHASE_STORAGE, 10000);
		ret = outbox_ack(&queue, p.sequence);
		if (ret) { return ret; }
		tracker_trial_mark(TRIAL_UPLOAD_ACKNOWLEDGED);
		printk("Position acknowledged: %llu\n", (unsigned long long)p.sequence);
	}
	return 0;
}

static void offline_and_drain_dns(void)
{
	/* AT shutdown and the non-cancellable resolver share one finite recovery
	 * lease. Never reinitialize the modem or reuse its job while DNS is alive. */
	supervisor_enter(PHASE_CLEANUP, 20000);
	int ret = lte_lc_func_mode_set(LTE_LC_FUNC_MODE_OFFLINE);
	if (ret) { supervisor_reset("Modem offline failed"); }
	if (!tracker_dns_wait_idle(15000)) { supervisor_reset("DNS worker did not finish"); }
}

int main(void)
{
	uint32_t reset_cause;
	int ret = supervisor_init(&reset_cause);
	if (ret) { printk("SERVICE HOLD: watchdog/reset-cause initialization %d; radio stays off\n", ret); return 0; }
	tracker_trial_init();
	printk("Collar tracker r03 prototype; reset cause=%u; waiting 1000ms for VIO\n", reset_cause);
	k_msleep(1000);
	ret = gpio_is_ready_dt(&health) ? gpio_pin_configure_dt(&health, GPIO_OUTPUT_INACTIVE) : -ENODEV;
	if (ret) { supervisor_service_hold("Expansion disable failed"); }
	ret = device_init(bus);
	if (ret) { printk("Gauge unavailable: I2C init %d\n", ret); }
	supervisor_enter(PHASE_STORAGE, 10000);
	ret = storage_init();
	if (ret) { supervisor_service_hold("Persistent store mount or validation failed"); }
	if (reset_cause & (RESET_WATCHDOG | RESET_CPU_LOCKUP)) {
		printk("Recovery cooldown: 120 seconds before enabling the modem\n");
		supervisor_sleep(120000);
	}
	supervisor_enter(PHASE_MODEM, 30000);
	ret = nrf_modem_lib_init();
	if (ret) { supervisor_reset("Modem initialization failed"); }
	ret = lte_lc_func_mode_set(LTE_LC_FUNC_MODE_OFFLINE);
	if (ret) { supervisor_reset("Initial modem offline failed"); }
	ret = lte_lc_system_mode_set(LTE_LC_SYSTEM_MODE_LTEM_GPS, LTE_LC_SYSTEM_MODE_PREFER_AUTO);
	if (ret) { supervisor_reset("LTE-M/GNSS mode configuration failed"); }
	ret = nrf_modem_gnss_event_handler_set(gnss_event);
	if (ret) {
		supervisor_reset("GNSS handler setup failed");
	}
	int provisioned = uplink_configured();
	printk("Uplink provisioning result: %d (zero means configured)\n", provisioned);
	while (queue.healthy) {
		int64_t started = k_uptime_get();
		struct position p;
		supervisor_enter(PHASE_FIX, CONFIG_TRACKER_FIX_SECONDS * 1000U + 10000U);
		ret = acquire(&p);
		if (ret == 0) {
			supervisor_enter(PHASE_STORAGE, 10000);
			ret = outbox_enqueue(&queue, &p);
			if (!ret) { tracker_trial_mark(TRIAL_FIX_PERSISTED); }
			printk("Position persistence: %d\n", ret);
			if (ret == -ENOSPC) { printk("OUTBOX FULL: newest fix rejected; older fixes retained\n"); }
		} else { printk("No usable GNSS fix: %d\n", ret); }
		offline_and_drain_dns();
		if (!queue.healthy) { supervisor_reset("Outbox mutation needs reboot reconciliation"); }
		if (queue.healthy && provisioned == 0) { printk("Uplink result: %d\n", drain()); }
		offline_and_drain_dns();
		if (!queue.healthy) { supervisor_reset("Outbox acknowledgment needs reboot reconciliation"); }
		tracker_trial_confirm_if_ready();
		int64_t wait = CONFIG_TRACKER_INTERVAL_SECONDS * INT64_C(1000) - (k_uptime_get() - started);
		if (tracker_trial_pending()) { wait = 60000; }
		/* Slow cycles never spin or immediately restart a failed connection. */
		supervisor_sleep((uint32_t)(wait > 60000 ? wait : 60000));
	}
	supervisor_service_hold("Tracker stopped");
}
```

## src/trial.c
```c
#include "trial.h"
#include "supervisor.h"
#include <zephyr/dfu/mcuboot.h>
#include <zephyr/kernel.h>
#include <zephyr/sys/printk.h>

static struct trial_policy trial;
static struct k_spinlock lock;
K_SEM_DEFINE(trial_started, 0, 1);

static void monitor(void *a, void *b, void *c)
{
	ARG_UNUSED(a); ARG_UNUSED(b); ARG_UNUSED(c);
	k_sem_take(&trial_started, K_FOREVER);
	for (;;) {
		k_spinlock_key_t key = k_spin_lock(&lock);
		bool expired = trial_policy_expired(&trial, k_uptime_get());
		bool done = trial.state == TRIAL_CONFIRMED;
		k_spin_unlock(&lock, key);
		if (expired) { supervisor_reset("Firmware trial deadline expired; leave image unconfirmed"); }
		if (done) { return; }
		k_sleep(K_SECONDS(1));
	}
}
K_THREAD_DEFINE(trial_thread, 1024, monitor, NULL, NULL, NULL, 2, 0, 0);

void tracker_trial_init(void)
{
	/* MCUboot treats an initial image with an unset trailer as confirmed. */
	bool pending = !boot_is_img_confirmed();
	k_spinlock_key_t key = k_spin_lock(&lock);
	bool okay = trial_policy_init(&trial, k_uptime_get(), pending,
		CONFIG_TRACKER_TRIAL_SECONDS * 1000U, CONFIG_TRACKER_TRIAL_STABLE_SECONDS * 1000U);
	k_spin_unlock(&lock, key);
	if (!okay) { supervisor_reset("Invalid firmware trial configuration"); }
	if (pending) {
		printk("Firmware trial: require a fresh persisted fix and an acknowledged upload\n");
		k_sem_give(&trial_started);
	}
}

void tracker_trial_mark(enum trial_evidence evidence)
{
	k_spinlock_key_t key = k_spin_lock(&lock);
	trial_policy_mark(&trial, evidence);
	k_spin_unlock(&lock, key);
}

bool tracker_trial_pending(void)
{
	k_spinlock_key_t key = k_spin_lock(&lock);
	bool pending = trial.state == TRIAL_PENDING || trial.state == TRIAL_CONFIRMING;
	k_spin_unlock(&lock, key);
	return pending;
}

void tracker_trial_confirm_if_ready(void)
{
	k_spinlock_key_t key = k_spin_lock(&lock);
	enum trial_action action = trial_policy_decide(&trial, k_uptime_get());
	k_spin_unlock(&lock, key);
	if (action == TRIAL_RESET) { supervisor_reset("Firmware trial expired before confirmation"); }
	if (action != TRIAL_CONFIRM) { return; }
	supervisor_enter(PHASE_STORAGE, 10000);
	int ret = boot_write_img_confirmed();
	key = k_spin_lock(&lock);
	bool accepted = trial_policy_finish(&trial, k_uptime_get(), ret == 0);
	k_spin_unlock(&lock, key);
	if (!accepted) { supervisor_reset("Firmware trial confirmation failed"); }
	printk("Firmware trial confirmed\n");
}
```

## src/trial.h
```c
#ifndef COLLAR_TRIAL_H
#define COLLAR_TRIAL_H
#include "trial_policy.h"
void tracker_trial_init(void);
void tracker_trial_mark(enum trial_evidence evidence);
void tracker_trial_confirm_if_ready(void);
bool tracker_trial_pending(void);
#endif
```

## src/trial_policy.c
```c
#include "trial_policy.h"
#include <limits.h>

bool trial_policy_init(struct trial_policy *p, int64_t now, bool pending,
		       uint32_t budget_ms, uint32_t stable_ms)
{
	*p = (struct trial_policy){.state = pending ? TRIAL_PENDING : TRIAL_CONFIRMED};
	if (!pending) { return true; }
	if (now < 0 || budget_ms <= stable_ms || budget_ms - stable_ms <= 15000 ||
	    now > INT64_MAX - budget_ms) {
		p->state = TRIAL_FAILED;
		return false;
	}
	p->deadline = now + budget_ms;
	p->earliest = now + stable_ms;
	return true;
}

bool trial_policy_expired(struct trial_policy *p, int64_t now)
{
	if (p->state != TRIAL_CONFIRMED && (now < 0 || now >= p->deadline)) {
		p->state = TRIAL_FAILED;
	}
	return p->state == TRIAL_FAILED;
}

void trial_policy_mark(struct trial_policy *p, enum trial_evidence evidence)
{
	if (p->state == TRIAL_PENDING) {
		p->evidence |= (unsigned)evidence & (TRIAL_FIX_PERSISTED | TRIAL_UPLOAD_ACKNOWLEDGED);
	}
}

enum trial_action trial_policy_decide(struct trial_policy *p, int64_t now)
{
	if (trial_policy_expired(p, now)) { return TRIAL_RESET; }
	if (p->state == TRIAL_CONFIRMED) { return TRIAL_DONE; }
	if (p->state != TRIAL_PENDING || now < p->earliest || p->deadline - now < 15000 ||
	    p->evidence != (TRIAL_FIX_PERSISTED | TRIAL_UPLOAD_ACKNOWLEDGED)) { return TRIAL_WAIT; }
	/* Allow 10s for the flash write with another 5s before the trial deadline. */
	p->state = TRIAL_CONFIRMING;
	return TRIAL_CONFIRM;
}

bool trial_policy_finish(struct trial_policy *p, int64_t now, bool success)
{
	if (trial_policy_expired(p, now) || p->state != TRIAL_CONFIRMING || !success) {
		p->state = TRIAL_FAILED;
		return false;
	}
	p->state = TRIAL_CONFIRMED;
	return true;
}
```

## src/trial_policy.h
```c
#ifndef COLLAR_TRIAL_POLICY_H
#define COLLAR_TRIAL_POLICY_H
#include <stdbool.h>
#include <stdint.h>

enum trial_state { TRIAL_CONFIRMED, TRIAL_PENDING, TRIAL_CONFIRMING, TRIAL_FAILED };
enum trial_action { TRIAL_WAIT, TRIAL_CONFIRM, TRIAL_RESET, TRIAL_DONE };
enum trial_evidence { TRIAL_FIX_PERSISTED = 1, TRIAL_UPLOAD_ACKNOWLEDGED = 2 };
struct trial_policy {
	enum trial_state state;
	int64_t deadline, earliest;
	unsigned evidence;
};
/* Caller serializes every access. A factory image with no trial is already stable. */
bool trial_policy_init(struct trial_policy *p, int64_t now, bool pending,
		       uint32_t budget_ms, uint32_t stable_ms);
bool trial_policy_expired(struct trial_policy *p, int64_t now);
void trial_policy_mark(struct trial_policy *p, enum trial_evidence evidence);
enum trial_action trial_policy_decide(struct trial_policy *p, int64_t now);
bool trial_policy_finish(struct trial_policy *p, int64_t now, bool success);
#endif
```

## src/uplink.h
```c
#ifndef COLLAR_UPLINK_H
#define COLLAR_UPLINK_H
#include "outbox.h"
int uplink_configured(void);
int uplink_send(const struct position *position);
#endif
```
