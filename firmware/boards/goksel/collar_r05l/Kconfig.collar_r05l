## firmware/boards/goksel/collar_r05l/board.yml
```yaml
board:
  name: collar_r05l
  full_name: Collar tracker r05l
  vendor: others
  socs:
    - name: nrf9151
```

## firmware/boards/goksel/collar_r05l/collar_r05l_nrf9151_defconfig
```kconfig
CONFIG_ARM_MPU=y
CONFIG_ARM_TRUSTZONE_M=y
CONFIG_GPIO=y
CONFIG_PINCTRL=y
CONFIG_ENTROPY_NRF5_RNG=n
```

## firmware/boards/goksel/collar_tracker_r05l/board.yml
```yaml
board:
  name: collar_tracker_r05l
  full_name: Collar tracker r05l cellular application
  vendor: others
  socs:
    - name: nrf9151
      variants:
        - name: ns
```

## firmware/boards/goksel/collar_tracker_r05l/collar_tracker_r05l_nrf9151_ns_defconfig
```kconfig
CONFIG_ARM_MPU=y
CONFIG_ARM_TRUSTZONE_M=y
CONFIG_TRUSTED_EXECUTION_NONSECURE=y
CONFIG_GPIO=y
CONFIG_PINCTRL=y
CONFIG_ENTROPY_NRF5_RNG=n
```

## firmware/boards/goksel/collar_update_r05l/Kconfig.defconfig
```kconfig
if BOARD_COLLAR_UPDATE_R05L_NRF9151_NS

config BUILD_WITH_TFM
	default y

config TFM_FLASH_MERGED_BINARY
	default y

config USE_DT_CODE_PARTITION
	default y

endif
```

## firmware/boards/goksel/collar_update_r05l/board.yml
```yaml
board:
  name: collar_update_r05l
  full_name: Collar r05l with signed dual-slot updates
  vendor: others
  socs:
    - name: nrf9151
      variants:
        - name: ns
```

## firmware/dts/bindings/goksel,collar-r05l-io.yaml
```yaml
description: GPIO signals on the r05l collar tracker
compatible: "goksel,collar-r05l-io"
include: base.yaml
properties:
  charge-status-gpios:
    type: phandle-array
    required: true
  charge-fault-gpios:
    type: phandle-array
    required: true
  fuel-alert-gpios:
    type: phandle-array
    required: true
  health-enable-gpios:
    type: phandle-array
    required: true
```
